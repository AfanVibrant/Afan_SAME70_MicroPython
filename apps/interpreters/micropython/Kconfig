## apps/interpreters/micropython/Kconfig
```kconfig
#
# For a description of the syntax of this configuration file,
# see the file kconfig-language.txt in the NuttX tools repository.
#

config INTERPRETERS_MICROPYTHON
	bool "Micro Python support"
	default n
	---help---
		Enable support for the Micro Python interpreter

if INTERPRETERS_MICROPYTHON

config INTERPRETERS_MICROPYTHON_URL
	string "URL where Micro Python can be downloaded"
	default "https://github.com/micropython/micropython/archive"

config INTERPRETERS_MICROPYTHON_VERSION
	string "Version number"
	default "1.12"

config INTERPRETERS_MICROPYTHON_APPNAME
	string "Executable name"
	default "micropython"
	depends on NSH_BUILTIN_APPS

config INTERPRETERS_MICROPYTHON_STACKSIZE
	int "MicroPython stack size"
	default 8192
	depends on NSH_BUILTIN_APPS
	
config INTERPRETERS_MICROPYTHON_HEAPSIZE
    int "MicroPython heap size"
    default 16384
    depends on NSH_BUILTIN_APPS 

config INTERPRETERS_MICROPYTHON_PRIORITY
	int "Interpreter priority"
	default 100
	depends on NSH_BUILTIN_APPS

config INTERPRETERS_MICROPYTHON_PROGNAME
	string "Program name"
	default "micropython"
	depends on BUILD_KERNEL

endif # INTERPRETERS_MICROPYTHON
```
